## drivers/platform/wingtech/Kconfig
```kconfig
# Wingtech configuration options

config MACH_WT88047
	bool "WT88047 board"
	select MACH_WINGTECH_MSM8916
	help
	  Support for Wingtech WT88047 variant
```
